// Projeto 21 - Display de matriz de pontos LED - Mensagem com rolagem horizontal

#include <avr/pgmspace.h>
#include <TimerOne.h>
#include <string.h>

#define DATA_PIN            2        // Pino 1 no MAX
#define LOAD_PIN            3        // Pino 12 no MAX
#define CLOCK_PIN           4        // Pino 13 no MAX

#define DECODE_MODE        0x09
#define INTENSITY          0x0A
#define SCAN_LIMIT         0x0B
#define SHUTDOWN           0x0C
#define DISPLAY_TEST       0x0F

byte buffer[8];

// Caracteres imprimíveis da tabela ASCII (de 32 a 126)
const static byte font[][8] PROGMEM = {
                                       {B00000000, B00000000, B00000000, B00000000, B00000000, B00000000, B00000000, B00000000},
                                       {B00000100, B00000100, B00000100, B00000100, B00000100, B00000100, B00000000, B00000100}, 
                                       {B00001010, B00001010, B00001010, B00000000, B00000000, B00000000, B00000000, B00000000}, 
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                                       {B00000000, B00000000, B00000000, B00001010, B00011110, B00010100, B00000000, B00000000} 
                                      };

void clearDisplay()
{
  for (byte indice = 0; indice < 8; indice++)
    buffer[indice] = B00000000;

  screenUpdate();
}

void initializeMAX7219()
{
  pinMode(DATA_PIN, OUTPUT);
  pinMode(LOAD_PIN, OUTPUT);
  pinMode(CLOCK_PIN, OUTPUT);
  clearDisplay();
  writeData(DECODE_MODE, B00000000);             // Modo de decodificação desligado
  writeData(SCAN_LIMIT, B00000111);              // limite de varredura definido entre 0 e 7 (para matriz de pontos)
  writeData(SHUTDOWN, B00000001);                // define o registrador de desligamento (shutdown) para operação normal

  intensity(15);                                 // intensidade definida como máxima (valores de 0 à 15)
}

void intensity(byte intensity)
{
  writeData(INTENSITY, intensity); 
}

void writeData(byte msb, byte lsb)
{
  digitalWrite(LOAD_PIN, LOW);
  shiftOut(DATA_PIN, CLOCK_PIN, MSBFIRST, msb);
  shiftOut(DATA_PIN, CLOCK_PIN, MSBFIRST, lsb);
  digitalWrite(LOAD_PIN, HIGH);  
}

void scroll(const char *myString, unsigned rate)
{
  byte firstChrRow, secondChrRow;
  byte ledOutput,
       chrIndex = 0,
       char1, char2,
       scrollBit = 0;
       
  unsigned long timer;
  unsigned long counter;

  counter = millis();

  while(chrIndex < strlen(myString))
  {
    timer = millis();

    if(timer > (counter + rate))
    {
      char1 = constrain(myString[chrIndex], 32, 126);
      char2 = constrain(myString[chrIndex+1], 32, 126);

      for(byte indice = 0; indice < 8; indice++)
      {
        firstChrRow = pgm_read_byte(&font[char1 - 32][indice]);
        secondChrRow = (pgm_read_byte(&font[char2 - 32][indice])) << 1;
        ledOutput = (firstChrRow << scrollBit) | (secondChrRow >> (8 - scrollBit));
        buffer[indice] = ledOutput;
      }
      scrollBit++;

      if (scrollBit > 6)
      {
        scrollBit = 0;
        chrIndex++;
      }
      counter = millis();
      
    } // if
  }   // while 
}     // scroll

void screenUpdate()
{
  for(byte row = 0; row < 8; row++)
    writeData(row+1, buffer[row]);
}

void setup()
{
  initializeMAX7219();
  Timer1.initialize(10000);
  Timer1.attachInterrupt(screenUpdate);
  Serial.begin(9600);
}

void loop()
{
  clearDisplay();
  //scroll("  BEGINNING ARDUINO  ", 50);
  //scroll("  Chapter 7 - LED Displays  ", 50);
  scroll("  MINERVA ROCKETS  ", 50);  
}
